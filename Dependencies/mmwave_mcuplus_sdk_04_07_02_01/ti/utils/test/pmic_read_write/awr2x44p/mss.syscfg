/**
 * @cliArgs --device "AWR2X44P" --part "Default" --package "LOP" --context "r5fss0-0" --product "MCU_PLUS_SDK_AWR2X44P@10.00.00"
 * @versions {"tool":"1.21.0+3721"}
 */

/**
 * Import the modules used in this configuration.
 */
const edma       = scripting.addModule("/drivers/edma/edma", {}, false);
const edma1      = edma.addInstance();
const mibspi     = scripting.addModule("/drivers/mibspi/mibspi", {}, false);
const mibspi1    = mibspi.addInstance();
const clock      = scripting.addModule("/kernel/dpl/clock");
const debug_log  = scripting.addModule("/kernel/dpl/debug_log");
const mpu_armv7  = scripting.addModule("/kernel/dpl/mpu_armv7", {}, false);
const mpu_armv71 = mpu_armv7.addInstance();
const mpu_armv72 = mpu_armv7.addInstance();
const mpu_armv73 = mpu_armv7.addInstance();
const mpu_armv74 = mpu_armv7.addInstance();
const mpu_armv75 = mpu_armv7.addInstance();
const mpu_armv76 = mpu_armv7.addInstance();
const mpu_armv77 = mpu_armv7.addInstance();

/**
 * Write custom configuration values to the imported modules.
 */
mibspi1.$name                  = "CONFIG_MIBSPI0";
mibspi1.t2cDelay               = 0x5;
mibspi1.c2tDelay               = 0x5;
mibspi1.dataSize               = 8;
mibspi1.frameFormat            = "POL0_PHA1";
mibspi1.advanced               = true;
mibspi1.csHold                 = true;
mibspi1.instance               = "MIBSPIB";
mibspi1.bitRate                = 1000000;
mibspi1.MIBSPI.$assign         = "MIBSPIB";
mibspi1.MIBSPI.CLK.$assign     = "PAD_AJ";
mibspi1.MIBSPI.MISO.$assign    = "PAD_AI";
mibspi1.MIBSPI.MOSI.$assign    = "PAD_AH";
mibspi1.mibspiChannel[0].$name = "CONFIG_MIBSPI_CH0";

edma1.$name                             = "CONFIG_EDMA1";
mibspi1.edmaConfig                      = edma1;
edma1.edmaRmDmaCh[0].$name              = "CONFIG_EDMA_RM5";
edma1.edmaRmDmaCh[0].resourceType       = scripting.forceWrite("ownDmaCh");
edma1.edmaRmQdmaCh[0].$name             = "CONFIG_EDMA_RM6";
edma1.edmaRmTcc[0].$name                = "CONFIG_EDMA_RM7";
edma1.edmaRmParam[0].$name              = "CONFIG_EDMA_RM8";
edma1.edmaRmReservedDmaCh[0].$name      = "CONFIG_EDMA_RM9";
edma1.edmaRmReservedDmaCh[0].startIndex = 6;
edma1.edmaRmReservedDmaCh[0].endIndex   = 7;

debug_log.enableCssLog            = false;
debug_log.enableUartLog           = true;
debug_log.uartLog.$name           = "CONFIG_UART0";
debug_log.uartLog.UART.$assign    = "UARTA";
debug_log.uartLog.UART.RX.$assign = "PAD_DA";
debug_log.uartLog.UART.TX.$assign = "PAD_DB";

const edma2                        = edma.addInstance({}, false);
edma2.$name                        = "CONFIG_EDMA0";
debug_log.uartLog.edmaConfig       = edma2;
edma2.edmaRmDmaCh[0].$name         = "CONFIG_EDMA_RM0";
edma2.edmaRmQdmaCh[0].$name        = "CONFIG_EDMA_RM1";
edma2.edmaRmTcc[0].$name           = "CONFIG_EDMA_RM2";
edma2.edmaRmParam[0].$name         = "CONFIG_EDMA_RM3";
edma2.edmaRmReservedDmaCh[0].$name = "CONFIG_EDMA_RM4";

mpu_armv71.$name        = "CONFIG_MPU_REGION0";
mpu_armv71.attributes   = "Device";
mpu_armv71.allowExecute = false;

mpu_armv72.$name = "CONFIG_MPU_REGION1";
mpu_armv72.size  = 14;

mpu_armv73.$name    = "CONFIG_MPU_REGION2";
mpu_armv73.baseAddr = 0x80000;
mpu_armv73.size     = 14;

mpu_armv74.$name    = "CONFIG_MPU_REGION3";
mpu_armv74.baseAddr = 0x10200000;
mpu_armv74.size     = 20;

mpu_armv75.$name        = "CONFIG_MPU_REGION4";
mpu_armv75.baseAddr     = 0x102E0000;
mpu_armv75.size         = 16;
mpu_armv75.attributes   = "NonCached";
mpu_armv75.allowExecute = false;

mpu_armv76.$name        = "CONFIG_MPU_REGION5";
mpu_armv76.baseAddr     = 0xC5000000;
mpu_armv76.size         = 13;
mpu_armv76.attributes   = "NonCached";
mpu_armv76.allowExecute = false;

mpu_armv77.$name        = "CONFIG_MPU_REGION6";
mpu_armv77.baseAddr     = 0xA4030000;
mpu_armv77.size         = 12;
mpu_armv77.attributes   = "NonCached";
mpu_armv77.allowExecute = false;

/**
 * Pinmux solution for unlocked pins/peripherals. This ensures that minor changes to the automatic solver in a future
 * version of the tool will not impact the pinmux you originally saw.  These lines can be completely deleted in order to
 * re-solve from scratch.
 */
mibspi1.mibspiChannel[0].MSS_CSn.$suggestSolution = "PAD_AK";
