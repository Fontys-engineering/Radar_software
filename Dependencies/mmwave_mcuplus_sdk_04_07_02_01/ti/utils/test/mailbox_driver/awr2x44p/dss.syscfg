/**
 * @cliArgs --device "AWR2X44P" --package "LOP" --part "Default" --context "c66ss0" --product "MCU_PLUS_SDK_AWR2X44P@09.02.00"
 * @versions {"tool":"1.20.0+3587"}
 */

/**
 * Import the modules used in this configuration.
 */
const ipc       = scripting.addModule("/drivers/ipc/ipc");
const cache_c6x = scripting.addModule("/kernel/dpl/cache_c6x");
const debug_log = scripting.addModule("/kernel/dpl/debug_log");

/**
 * Write custom configuration values to the imported modules.
 */
ipc.r5fss0_0 = "NONE";
ipc.m4ss0_1  = "NONE";

cache_c6x.marRegionConfig.create(3);
cache_c6x.marRegionConfig[0].$name    = "kernel_dpl_cache_c6x_mar0";
cache_c6x.marRegionConfig[0].baseAddr = 0xC5000000;
cache_c6x.marRegionConfig[1].$name    = "kernel_dpl_cache_c6x_mar1";
cache_c6x.marRegionConfig[1].baseAddr = 0x83000000;
cache_c6x.marRegionConfig[2].$name    = "kernel_dpl_cache_c6x_mar2";
cache_c6x.marRegionConfig[2].baseAddr = 0xA4000000;

debug_log.enableCssLog = false;
