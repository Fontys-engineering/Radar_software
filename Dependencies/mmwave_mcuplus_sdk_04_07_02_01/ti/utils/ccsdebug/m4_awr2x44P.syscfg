/**
 * @cliArgs --device "AWR2X44P" --package "LOP" --part "Default" --context "m4ss0-1" --product "MCU_PLUS_SDK_AWR2X44P@09.02.00"
 * @versions {"tool":"1.20.0+3587"}
 */

/**
 * Import the modules used in this configuration.
 */
const clock      = scripting.addModule("/kernel/dpl/clock");
const debug_log  = scripting.addModule("/kernel/dpl/debug_log");
const mpu_armv7  = scripting.addModule("/kernel/dpl/mpu_armv7", {}, false);
const mpu_armv71 = mpu_armv7.addInstance();
const mpu_armv72 = mpu_armv7.addInstance();

mpu_armv71.$name      = "CONFIG_MPU_REGION0";
mpu_armv71.attributes = "Device";

mpu_armv72.$name      = "CONFIG_MPU_REGION1";
mpu_armv72.baseAddr   = 0x88000000;
mpu_armv72.size       = 21;
mpu_armv72.attributes = "NonCached";
