/**
 * These arguments were used when this file was generated. They will be automatically applied on subsequent loads
 * via the GUI or CLI. Run CLI with '--help' for additional information on how to override these arguments.
 * @cliArgs --device "AWR2X44P" --part "Default" --package "LOP" --context "r5fss0-0" --product "MCU_PLUS_SDK_AWR2X44P@10.01.00"
 * @v2CliArgs --device "AWR2944P" --package "FCCSP (AMX)" --context "r5fss0-0" --product "MCU_PLUS_SDK_AWR2X44P@10.01.00"
 * @versions {"tool":"1.22.0+3893"}
 */

/**
 * Import the modules used in this configuration.
 */
const ipc       = scripting.addModule("/drivers/ipc/ipc");
const debug_log = scripting.addModule("/kernel/dpl/debug_log");

/**
 * Write custom configuration values to the imported modules.
 */
ipc.c66ss0           = "NONE";
ipc.enableMailboxIpc = false;
ipc.vringMsgSize     = 512;
ipc.vringNumBuf      = 4;
