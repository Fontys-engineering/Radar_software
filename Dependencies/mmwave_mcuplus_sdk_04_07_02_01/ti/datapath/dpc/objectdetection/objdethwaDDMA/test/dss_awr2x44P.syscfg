/**
 * @cliArgs --device "AWR2X44P" --part "Default" --package "LOP" --context "c66ss0" --product "MCU_PLUS_SDK_AWR2X44P@10.00.00"
 * @versions {"tool":"1.21.0+3721"}
 */

/**
 * Import the modules used in this configuration.
 */
const ipc       = scripting.addModule("/drivers/ipc/ipc");
const cache_c6x = scripting.addModule("/kernel/dpl/cache_c6x");
const debug_log = scripting.addModule("/kernel/dpl/debug_log");

/**
 * Write custom configuration values to the imported modules.
 */
ipc.r5fss0_0         = "NONE";
ipc.vringMsgSize     = 512;
ipc.vringNumBuf      = 4;
ipc.enableMailboxIpc = false;

cache_c6x.marRegionConfig.create(2);
cache_c6x.marRegionConfig[0].$name          = "kernel_dpl_cache_c6x_mar0";
cache_c6x.marRegionConfig[0].baseAddr       = 0xC5000000;
cache_c6x.marRegionConfig[1].$name          = "kernel_dpl_cache_c6x_mar1";
cache_c6x.marRegionConfig[1].baseAddr       = 0x88000000;
cache_c6x.marRegionConfig[1].enablePrefetch = true;
