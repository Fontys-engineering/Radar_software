/**
 * @cliArgs --device "AWR2X44P" --part "Default" --package "LOP" --context "m4ss0-1" --product "MCU_PLUS_SDK_AWR2X44P@10.01.00"
 * @versions {"tool":"1.22.0+3893"}
 */

/**
 * Import the modules used in this configuration.
 */
const edma      = scripting.addModule("/drivers/edma/edma", {}, false);
const edma1     = edma.addInstance();
const hwa       = scripting.addModule("/drivers/hwa/hwa", {}, false);
const hwa1      = hwa.addInstance();
const ipc       = scripting.addModule("/drivers/ipc/ipc");
const debug_log = scripting.addModule("/kernel/dpl/debug_log");

/**
 * Write custom configuration values to the imported modules.
 */
edma1.$name                             = "CONFIG_EDMA0";
edma1.instance                          = "EDMA_DSS_A";
edma1.edmaRmDmaCh[0].$name              = "CONFIG_EDMA_RM0";
edma1.edmaRmDmaCh[0].resourceType       = scripting.forceWrite("ownDmaCh");
edma1.edmaRmDmaCh[0].startIndex         = 0;
edma1.edmaRmQdmaCh[0].$name             = "CONFIG_EDMA_RM1";
edma1.edmaRmQdmaCh[0].startIndex        = 0;
edma1.edmaRmTcc[0].$name                = "CONFIG_EDMA_RM2";
edma1.edmaRmTcc[0].startIndex           = 0;
edma1.edmaRmParam[0].$name              = "CONFIG_EDMA_RM3";
edma1.edmaRmParam[0].startIndex         = 0;
edma1.edmaRmReservedDmaCh[0].$name      = "CONFIG_EDMA_RM4";
edma1.edmaRmReservedDmaCh[0].startIndex = 0;
edma1.edmaRmReservedDmaCh[0].endIndex   = 0;

hwa1.$name = "CONFIG_HWA0";

ipc.vringMsgSize = 512;
ipc.vringNumBuf  = 4;
ipc.intrPriority = 5;
ipc.c66ss0       = "NONE";
