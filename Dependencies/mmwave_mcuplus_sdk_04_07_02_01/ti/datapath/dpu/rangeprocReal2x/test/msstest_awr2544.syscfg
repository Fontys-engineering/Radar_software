/**
 * @cliArgs --device "AWR2544" --part "Default" --package "LOP" --context "r5fss0-0" --product "MCU_PLUS_SDK_AWR2544@10.00.00"
 * @versions {"tool":"1.21.0+3721"}
 */

/**
 * Import the modules used in this configuration.
 */
const edma       = scripting.addModule("/drivers/edma/edma", {}, false);
const edma1      = edma.addInstance();
const hwa        = scripting.addModule("/drivers/hwa/hwa", {}, false);
const hwa1       = hwa.addInstance();
const clock      = scripting.addModule("/kernel/dpl/clock");
const debug_log  = scripting.addModule("/kernel/dpl/debug_log");
const mpu_armv7  = scripting.addModule("/kernel/dpl/mpu_armv7", {}, false);
const mpu_armv71 = mpu_armv7.addInstance();
const mpu_armv72 = mpu_armv7.addInstance();
const mpu_armv73 = mpu_armv7.addInstance();
const mpu_armv74 = mpu_armv7.addInstance();
const mpu_armv75 = mpu_armv7.addInstance();
const mpu_armv76 = mpu_armv7.addInstance();

/**
 * Write custom configuration values to the imported modules.
 */
edma1.$name                       = "CONFIG_EDMA0";
edma1.enableOwnQdmaChannelConfig  = false;
edma1.enableReservedChannelConfig = false;
edma1.regionId                    = 0;
edma1.instance                    = "EDMA_DSS_A";
edma1.edmaRmDmaCh[0].$name        = "CONFIG_EDMA_RM0";
edma1.edmaRmTcc[0].$name          = "CONFIG_EDMA_RM2";
edma1.edmaRmTcc[0].endIndex       = 63;
edma1.edmaRmParam[0].$name        = "CONFIG_EDMA_RM3";

hwa1.$name                                       = "CONFIG_HWA0";
hwa1.configParamset.create(5);
hwa1.configParamset[0].$name                     = "HWA_PARAMSET_CONFIG0";
hwa1.configParamset[0].triggerMode               = "HWA_TRIG_MODE_DMA";
hwa1.configParamset[1].$name                     = "HWA_PARAMSET_CONFIG1";
hwa1.configParamset[1].triggerMode               = "HWA_TRIG_MODE_DMA";
hwa1.configParamset[1].triggerSrc                = 1;
hwa1.configParamset[1].accelMode                 = "HWA_ACCELMODE_FFT";
hwa1.configParamset[1].dcEstResetMode            = "HWA_DCEST_INTERFSUM_RESET_MODE_PARAMRESET";
hwa1.configParamset[1].srcBcnt                   = 3;
hwa1.configParamset[1].srcSign                   = "HWA_SAMPLES_SIGNED";
hwa1.configParamset[1].srcScale                  = 8;
hwa1.configParamset[1].dstSign                   = "HWA_SAMPLES_SIGNED";
hwa1.configParamset[1].srcAcnt                   = 383;
hwa1.configParamset[1].dstAcnt                   = 383;
hwa1.configParamset[1].srcAIdx                   = 8;
hwa1.configParamset[1].srcBIdx                   = 2;
hwa1.configParamset[1].srcRealComplex            = "HWA_SAMPLES_FORMAT_REAL";
hwa1.configParamset[1].dstAIdx                   = 8;
hwa1.configParamset[1].dstBIdx                   = 2;
hwa1.configParamset[1].dstRealComplex            = "HWA_SAMPLES_FORMAT_REAL";
hwa1.configParamset[2].$name                     = "HWA_PARAMSET_CONFIG2";
hwa1.configParamset[2].accelMode                 = "HWA_ACCELMODE_FFT";
hwa1.configParamset[2].dcSubEnable               = true;
hwa1.configParamset[2].dcSubSelect               = "HWA_DCSUB_SELECT_DCEST";
hwa1.configParamset[2].interfEstResetMode        = "HWA_DCEST_INTERFSUM_RESET_MODE_PARAMRESET";
hwa1.configParamset[2].srcBcnt                   = 3;
hwa1.configParamset[2].srcSign                   = "HWA_SAMPLES_SIGNED";
hwa1.configParamset[2].srcScale                  = 8;
hwa1.configParamset[2].srcAcnt                   = 383;
hwa1.configParamset[2].dstAcnt                   = 383;
hwa1.configParamset[2].srcAIdx                   = 8;
hwa1.configParamset[2].srcBIdx                   = 2;
hwa1.configParamset[2].srcRealComplex            = "HWA_SAMPLES_FORMAT_REAL";
hwa1.configParamset[2].dstAIdx                   = 8;
hwa1.configParamset[2].dstBIdx                   = 2;
hwa1.configParamset[2].dstRealComplex            = "HWA_SAMPLES_FORMAT_REAL";
hwa1.configParamset[2].dstSign                   = "HWA_SAMPLES_SIGNED";
hwa1.configParamset[3].$name                     = "HWA_PARAMSET_CONFIG3";
hwa1.configParamset[3].accelMode                 = "HWA_ACCELMODE_FFT";
hwa1.configParamset[3].interfLocalizeEnable      = true;
hwa1.configParamset[3].interfThresholdMode       = "HWA_INTERFTHRESH_MODE_MAGDIFF";
hwa1.configParamset[3].interfThresholdSelect     = "HWA_INTERFTHRESH_SELECT_EST_INDIVIDUAL";
hwa1.configParamset[3].interfMitigEnable         = true;
hwa1.configParamset[3].interfMitigCountThreshold = 1;
hwa1.configParamset[3].interfMitigPathSelect     = "HWA_INTERFMITIGATION_PATH_WINDOWZEROOUT";
hwa1.configParamset[3].fftEn                     = true;
hwa1.configParamset[3].fftSize                   = 7;
hwa1.configParamset[3].fftSize3xEn               = true;
hwa1.configParamset[3].butterflyScaling          = 7;
hwa1.configParamset[3].windowSymm                = true;
hwa1.configParamset[3].srcAddr                   = 32768;
hwa1.configParamset[3].destAddr                  = 0;
hwa1.configParamset[3].srcAcnt                   = 383;
hwa1.configParamset[3].srcSign                   = "HWA_SAMPLES_SIGNED";
hwa1.configParamset[3].srcScale                  = 8;
hwa1.configParamset[3].dstSign                   = "HWA_SAMPLES_SIGNED";
hwa1.configParamset[3].srcAIdx                   = 8;
hwa1.configParamset[3].srcBcnt                   = 3;
hwa1.configParamset[3].srcBIdx                   = 2;
hwa1.configParamset[3].srcRealComplex            = "HWA_SAMPLES_FORMAT_REAL";
hwa1.configParamset[3].dstAcnt                   = 191;
hwa1.configParamset[3].dstAIdx                   = 16;
hwa1.configParamset[3].dstBIdx                   = 4;
hwa1.configParamset[3].windowMode                = "HWA_WINDOW_MODE_16BITREAL";
hwa1.configParamset[3].windowEn                  = true;
hwa1.configParamset[3].interfMitigLeftHystOrder  = 2;
hwa1.configParamset[3].interfMitigRightHystOrder = 2;
hwa1.configParamset[4].$name                     = "HWA_PARAMSET_CONFIG4";
hwa1.configParamset[4].accelMode                 = "HWA_ACCELMODE_COMPRESS";
hwa1.configParamset[4].cmpScaleFactorBW          = 4;
hwa1.configParamset[4].srcSign                   = "HWA_SAMPLES_SIGNED";
hwa1.configParamset[4].srcScale                  = 8;
hwa1.configParamset[4].srcAcnt                   = 7;
hwa1.configParamset[4].srcAIdx                   = 4;
hwa1.configParamset[4].srcBcnt                   = 23;
hwa1.configParamset[4].srcBIdx                   = 96;
hwa1.configParamset[4].dstAcnt                   = 3;
hwa1.configParamset[4].dstAIdx                   = 4;
hwa1.configParamset[4].dstBIdx                   = 48;
hwa1.configCommon[0].$name                       = "HWA_COMMON_CONFIG0";
hwa1.configCommon[0].numLoops                    = 384;
hwa1.configCommon[0].paramStopIdx                = 9;
hwa1.configCommon[0].lfsrSeed                    = 0xB;
hwa1.configCommon[0].twidDitherEnable            = false;
hwa1.configCommon[0].configMask                  = ["HWA_COMMONCONFIG_MASK_DCEST_SCALESHIFT","HWA_COMMONCONFIG_MASK_EGECOMRESS_KPARAM","HWA_COMMONCONFIG_MASK_INTERFSUM_MAG","HWA_COMMONCONFIG_MASK_INTERFSUM_MAGDIFF","HWA_COMMONCONFIG_MASK_INTERF_MITG_WINDOW_PARAM","HWA_COMMONCONFIG_MASK_LFSRSEED","HWA_COMMONCONFIG_MASK_STATEMACHINE_CFG","HWA_COMMONCONFIG_MASK_TWIDDITHERENABLE","HWA_COMMONCONFIG_MASK_TWIDINCR_DELTA_FRAC"];
hwa1.configCommon[0].EGEKparam_HWA_CMP_K_ARR_LEN = "3 4 5 7 9 11 13 15";

debug_log.enableCssLog = false;

mpu_armv71.$name        = "CONFIG_MPU_REGION0";
mpu_armv71.attributes   = "Device";
mpu_armv71.allowExecute = false;

mpu_armv72.$name = "CONFIG_MPU_REGION1";
mpu_armv72.size  = 16;

mpu_armv73.$name    = "CONFIG_MPU_REGION2";
mpu_armv73.baseAddr = 0x80000;
mpu_armv73.size     = 14;

mpu_armv74.$name    = "CONFIG_MPU_REGION3";
mpu_armv74.baseAddr = 0x10200000;
mpu_armv74.size     = 20;

mpu_armv75.$name        = "CONFIG_MPU_REGION4";
mpu_armv75.baseAddr     = 0x102E0000;
mpu_armv75.size         = 16;
mpu_armv75.allowExecute = false;

mpu_armv76.$name        = "CONFIG_MPU_REGION5";
mpu_armv76.baseAddr     = 0xC5000000;
mpu_armv76.size         = 13;
mpu_armv76.allowExecute = false;
mpu_armv76.attributes   = "NonCached";
